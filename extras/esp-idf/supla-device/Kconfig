## extras/esp-idf/supla-device/Kconfig
```kconfig
config SUPLA_DEBUG_BUILD
    bool "Supla debug build"
    help
      Configures project to build in production mode. SUPLA_DEBUG flag is
      not added and SUPLA_DISABLE_LOGS is added"

config SUPLA_DISABLE_LOGS
    bool "Disable logs in debug mode"
    depends on SUPLA_DEBUG_BUILD
    help
      Disables Supla logs in debug mode. In production mode they are always
      disabled.

config SUPLA_INSECURE_DEBUG_INTERFACE
    bool "Enable insecure SUPLA debug interfaces"
    depends on SUPLA_DEBUG_BUILD
    default n
    help
      Enables development-only local/network debug interfaces such as TCP log
      streaming. Do not enable in production firmware.
```

## extras/examples/esp8266_rtos/sdkconfig.defaults
```kconfig
CONFIG_IDF_TARGET_ESP8266=y
CONFIG_IDF_TARGET="esp8266"

CONFIG_ESPTOOLPY_FLASHSIZE_2MB=y
CONFIG_ESPTOOLPY_FLASHSIZE="2MB"
CONFIG_SPI_FLASH_SIZE=0x200000

CONFIG_PARTITION_TABLE_CUSTOM=y
CONFIG_PARTITION_TABLE_CUSTOM_FILENAME="partitions.csv"
CONFIG_PARTITION_TABLE_OFFSET=0x8000
CONFIG_PARTITION_TABLE_FILENAME="partitions.csv"

CONFIG_FREERTOS_HZ=1000

CONFIG_ESPTOOLPY_BAUD=921600
CONFIG_ESPTOOLPY_BAUD_921600B=y
CONFIG_ESPTOOLPY_BAUD_115200B=y

# optimization is set to "release" even for debug, because of too slow ssl link
# establishment in debug mode
CONFIG_COMPILER_OPTIMIZATION_LEVEL_RELEASE=y

CONFIG_LOG_DEFAULT_LEVEL_VERBOSE=y
CONFIG_LOG_DEFAULT_LEVEL=5
CONFIG_SUPLA_DEBUG_BUILD=y
CONFIG_LOG_SET_LEVEL=y
CONFIG_ESP_TLS_INSECURE=y
CONFIG_ESP_TLS_SKIP_SERVER_CERT_VERIFY=y
CONFIG_HTTPD_MAX_REQ_HDR_LEN=1024

# disabling some curve options reduce ssl link setup time
CONFIG_MBEDTLS_ECP_DP_SECP521R1_ENABLED=
CONFIG_MBEDTLS_ECP_DP_BP256R1_ENABLED=
CONFIG_MBEDTLS_ECP_DP_BP384R1_ENABLED=
CONFIG_MBEDTLS_ECP_DP_BP512R1_ENABLED=
```

## extras/examples/esp_idf/sdkconfig.defaults
```kconfig
# Supla parameters:
CONFIG_SUPLA_DEBUG_BUILD=y
CONFIG_SUPLA_DISABLE_LOGS=n

# Logging parameters:
CONFIG_LOG_MAXIMUM_LEVEL_VERBOSE=y
CONFIG_LOG_MAXIMUM_LEVEL=5

CONFIG_IDF_CMAKE=y

CONFIG_APP_BUILD_TYPE_APP_2NDBOOT=y

CONFIG_ESPTOOLPY_FLASHSIZE_4MB=y
CONFIG_ESPTOOLPY_FLASHSIZE="4MB"
CONFIG_PARTITION_TABLE_CUSTOM=y
CONFIG_PARTITION_TABLE_CUSTOM_FILENAME="partitions.csv"
CONFIG_PARTITION_TABLE_FILENAME="partitions.csv"
CONFIG_PARTITION_TABLE_OFFSET=0x8000
CONFIG_PARTITION_TABLE_MD5=y

CONFIG_ESP_TLS_USING_MBEDTLS=y

CONFIG_ESP_SYSTEM_EVENT_QUEUE_SIZE=32
CONFIG_ESP_SYSTEM_EVENT_TASK_STACK_SIZE=2304
CONFIG_ESP_MAIN_TASK_STACK_SIZE=3584
CONFIG_ESP_MAIN_TASK_AFFINITY_CPU0=y

CONFIG_ESP_MAIN_TASK_AFFINITY=0x0
CONFIG_ESP_MINIMAL_SHARED_STACK_SIZE=2048

CONFIG_ESP_TIMER_TASK_STACK_SIZE=3584

CONFIG_FREERTOS_HZ=1000
CONFIG_FREERTOS_IDLE_TASK_STACKSIZE=1536
CONFIG_FREERTOS_ISR_STACKSIZE=1536
CONFIG_FREERTOS_TIMER_TASK_STACK_DEPTH=4096

# HTTP server buffer for parsing post messages
CONFIG_HTTPD_MAX_REQ_HDR_LEN=1024
```
