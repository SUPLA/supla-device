## extras/examples/suplan_poc1_esp_idf/main/Kconfig.projbuild
```kconfig
menu "SupLAN PoC1"

config SUPLAN_POC1_WIFI_SSID
  string "Wi-Fi SSID"
  default ""

config SUPLAN_POC1_WIFI_PASSWORD
  string "Wi-Fi password"
  default ""

choice SUPLAN_POC1_ROLE
  prompt "Static PoC1 node role"
  default SUPLAN_POC1_ROLE_A

config SUPLAN_POC1_ROLE_A
  bool "Node A (relay resource 50001)"

config SUPLAN_POC1_ROLE_B
  bool "Node B (Action Trigger resource 50002)"

endchoice

endmenu
```

## extras/examples/suplan_poc1_esp_idf/sdkconfig.defaults
```kconfig
CONFIG_SUPLAN_POC1_WIFI_SSID=""
CONFIG_SUPLAN_POC1_WIFI_PASSWORD=""
CONFIG_SUPLAN_POC1_ROLE_A=y
CONFIG_ESP_MAIN_TASK_STACK_SIZE=4096
CONFIG_ESP_WIFI_ENABLED=y
CONFIG_ESP_WIFI_DYNAMIC_RX_BUFFER_NUM=8
CONFIG_ESP_WIFI_DYNAMIC_TX_BUFFER_NUM=8
CONFIG_MBEDTLS_X509_CREATE_C=y
```

## extras/examples/suplan_poc2_esp_idf/main/Kconfig.projbuild
```kconfig
menu "SupLAN PoC2 fixture"

config SUPLAN_POC2_ROLE_A
    bool "Use PoC2 Device A"
    default n
    help
        Selects fixture Device A (1001). The default is Device B (1002).

config SUPLAN_POC2_UNICAST_PORT
    int "SupLAN UDP unicast port"
    range 1 65535
    default 2016

endmenu
```
